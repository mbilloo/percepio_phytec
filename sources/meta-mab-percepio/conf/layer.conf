## sources/meta-mab-percepio/conf/layer.conf
```bitbake
# We have a conf and classes directory, append to BBPATH
BBPATH .= ":${LAYERDIR}"

# We have a recipes directory, add to BBFILES
BBFILES += "${LAYERDIR}/recipes*/*/*.bb ${LAYERDIR}/recipes*/*/*.bbappend"

BBFILE_COLLECTIONS += "mab-percepio1.0"
BBFILE_PATTERN_mab-percepio1.0 := "^${LAYERDIR}/"
BBFILE_PRIORITY_mab-percepio1.0 = "20"

LAYERSERIES_COMPAT_mab-percepio1.0 = "sumo"
```
